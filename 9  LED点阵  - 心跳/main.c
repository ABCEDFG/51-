#include <reg51.h>
#include <intrins.h>

sbit SRCLK=P3^6;
sbit RCLK=P3^5;
sbit SER=P3^4;

typedef unsigned int u16;
typedef unsigned char u8;

u8 code aa[12][8]=
		{
		{0x41,0xff,0x01,0x7e,0x81,0x81,0x81,0x7e}, //10
        {0x00,0x00,0x32,0x49,0x49,0x3e,0x00,0x00}, //9
        {0x00,0x00,0x36,0x49,0x49,0x3e,0x00,0x00}, //8
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    	{0x00,0x18,0x3c,0x1e,0x1e,0x3c,0x18,0x00}, //С����
		};
u8 ledwei[]={0x7f,0xbf,0xdf,0xef,0xf7,0xfb,0xfd,0xfe};

void delay(u16 i)
{
   while(i--);
}


void Fasong(u8 dat)
{
   u8 a;
   SRCLK=0;
   RCLK=0;
   for(a=0;a<8;a++)
   {
   	  SER=dat>>7;
	  dat<<=1;
	  SRCLK=1;
	  _nop_();
	  _nop_();			    
	  SRCLK=0;

   }
   RCLK=1;
   _nop_();
   _nop_();
   RCLK=0;
}
void main()
{ 
  	u8 i,x,j,k,n,s; 
  	x=50000;
	n=0;
	s=100;
  	while(x)
  	{ 
    	for(j=n;j<12;j++)
		{
			for(k=0;k<s;k++)
			{ 
    			for(i=0;i<8;i++)
   	 			{
    	 	 	 	P0=0x7f;
   		 	 		P0=ledwei[i];
		 	 	 	Fasong(aa[j][i]);
		  	 		delay(100);
		  	 		Fasong(0x00);
  				}
  			}
   		}
		n=10;
		s=25;
	}
}